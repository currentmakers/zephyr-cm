## boards/currentmakers/colibri_mcu3/Kconfig
```kconfig
if BOARD_COLIBRI_MCU3

# Enable the Clock and GPIO drivers required for STM32
config GPIO
    default y

config CLOCK_CONTROL
    default y

config I2C
    default y

# Enable SPI and FLASH drivers so the W25Q128 works out of the box
config SPI
    default y

config FLASH
    default y

config SPI_NOR
    default y

# Enable PWM and LED Strip drivers for the WS2812
config PWM
    default y

config LED_STRIP
    default y

config SERIAL
    default y

config UART_INTERRUPT_DRIVEN
    default y

# Often used with the shell for debugging
config UART_CONSOLE
    default y

endif
```

## boards/currentmakers/colibri_mcu3/board.yml
```yaml
board:
  name: colibri_mcu3
  full_name: Colibri MCU3
  vendor: currentmakers
  socs:
    - name: stm32f405xx
```

## boards/currentmakers/streamline_mcu_stm32f407/Kconfig
```kconfig
config BOARD_STREAMLINE_MCU_STM32F407
	bool "Streamline MCU STM32F407"
	select SOC_SERIES_STM32F4X
	select SOC_STM32F407XE
	select ARM
	select HAS_FLASH_LOADER
	select SOC_HAS_TIMING_FUNCTIONS
```

## boards/currentmakers/streamline_mcu_stm32f407/board.yml
```yaml
board:
  name: streamline_mcu_stm32f407
  full_name: Streamline MCU STM32F407
  vendor: currentmakers
  socs:
    - name: stm32f407xx
```

## boards/shields/colibri_carrier/Kconfig.shield
```kconfig
config SHIELD_COLIBRI_CARRIER
    def_bool $(shields_list_contains,colibri_carrier)
```
