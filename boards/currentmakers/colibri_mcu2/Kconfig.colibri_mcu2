## boards/currentmakers/colibri_mcu2/board.yml
```yaml
board:
  name: colibri_mcu2
  full_name: Colibri MCU2
  vendor: currentmakers
  socs:
    - name: stm32h562xx
```

## boards/currentmakers/streamline_mcu_stm32c551/Kconfig.streamline_mcu_stm32c551
```kconfig
config BOARD_STREAMLINE_MCU_STM32C551
	bool "Streamline MCU STM32C551"
	select SOC_STM32C551XX
```

## boards/currentmakers/streamline_mcu_stm32c551/board.yml
```yaml
board:
  name: streamline_mcu_stm32c551
  full_name: Streamline MCU STM32C551
  vendor: currentmakers
  socs:
    - name: stm32c551xx
```

## boards/currentmakers/streamline_mcu_stm32f407/Kconfig.streamline_mcu_stm32f407
```kconfig
config BOARD_STREAMLINE_MCU_STM32F407
	bool "Streamline MCU STM32F407"
	select SOC_STM32F407XE
```

## boards/currentmakers/streamline_mcu_stm32h562/Kconfig.streamline_mcu_stm32h562
```kconfig
config BOARD_STREAMLINE_MCU_STM32H562
	bool "Streamline MCU STM32H562"
	select SOC_STM32H562XX
```

## boards/currentmakers/streamline_mcu_stm32h562/board.yml
```yaml
board:
  name: streamline_mcu_stm32h562
  full_name: Streamline MCU STM32H562
  vendor: currentmakers
  socs:
    - name: stm32c5x
```

## boards/currentmakers/streamline_mcu_stm32l475/Kconfig
```kconfig
config BOARD_STREAMLINE_MCU_STM32L475
	bool "Streamline MCU STM32L475"
	select SOC_SERIES_STM32L4X
	select SOC_STM32L475XE
	select ARM
	select HAS_FLASH_LOADER
	select SOC_HAS_TIMING_FUNCTIONS
```

## boards/currentmakers/streamline_mcu_stm32l475/Kconfig.streamline_mcu_stm32l475
```kconfig
config BOARD_STREAMLINE_MCU_STM32L475
	bool "Streamline MCU STM32L475"
	select SOC_STM32L475XX
	select SOC_STM32L4X
```

## boards/currentmakers/streamline_mcu_stm32l475/board.yml
```yaml
board:
  name: streamline_mcu_stm32l475
  full_name: Streamline MCU STM32L475
  vendor: currentmakers
  socs:
    - name: stm32l475xx
```

## boards/currentmakers/streamline_rp_2354/Kconfig.streamline_mcu_rp2350
```kconfig
config BOARD_STREAMLINE_MCU_RP2354
	bool "Streamline MCU RP2354"
	select SOC_RP2350
```

## boards/currentmakers/streamline_rp_2354/board.yml
```yaml
board:
  name: streamline_mcu_rp2354
  full_name: Streamline MCU RP2354
  vendor: currentmakers
  socs:
    - name: rp2350
```
